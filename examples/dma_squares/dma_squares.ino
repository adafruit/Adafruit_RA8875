#if defined(ARDUINO_SAM_DUE)
#include <SPI.h>
#include "Adafruit_I2CDevice.h"
#include "Adafruit_RA8875.h"
#include "function_timings.h"

// Library only supports hardware SPI at this time
// Connect SCLK to UNO Digital #13 (Hardware SPI clock)
// Connect MISO to UNO Digital #12 (Hardware SPI MISO)
// Connect MOSI to UNO Digital #11 (Hardware SPI MOSI)
#define RA8875_INT 23
#define RA8875_CS 10
#define RA8875_RESET 26

#define DISPLAY_WIDTH 800
#define DISPLAY_HEIGHT 480

#define draw_width (DISPLAY_WIDTH / 10)
#define draw_height (DISPLAY_HEIGHT / 6)

#define TRACE_DEBUG 0

#define SIZE draw_width * draw_height

uint16_t test_pixels[SIZE];
extern uint8_t test_arr_map[SIZE * 2]; // Multiply by 2 for uint8 -> uint16

Adafruit_RA8875 tft = Adafruit_RA8875(RA8875_CS, RA8875_RESET, true);
volatile bool ready = true;
int16_t x_pos = 0;
int16_t y_pos = 0;

static void test_spi_blocking() {
#if TRACE_DEBUG
  Serial.println("\r\nStarting draw (Blocking SPI)");
  uint32_t full_timing = micros();
#endif
  while(y_pos < DISPLAY_HEIGHT) {
    tft.drawPixelsArea((uint16_t*) test_arr_map, draw_height * draw_width, x_pos, y_pos, draw_width);
    if(x_pos + draw_width >= DISPLAY_WIDTH) {
      y_pos += draw_height;
      x_pos = 0;
    } else {
      x_pos += draw_width;
    }
    delay(250);
  }
#if TRACE_DEBUG
  Serial.println("Released draw");
  Serial.print("Total time: "); Serial.print(micros() - full_timing); Serial.println(" us");
#endif
}

static void test_dma_regular() {
#if USE_DMA_INTERRUPT
  if(y_pos >= DISPLAY_HEIGHT) {
    return;
  }
#if TRACE_DEBUG
  Serial.print("[ "); Serial.print(x_pos); Serial.print(", "); Serial.print(y_pos); Serial.println(" ]");
#endif
  tft.drawPixelsAreaDMASlow((uint16_t*) test_arr_map, draw_height * draw_width, x_pos, y_pos, draw_width, nullptr, [](void* data) {
    if(x_pos + draw_width >= DISPLAY_WIDTH) {
      y_pos += draw_height;
      x_pos = 0;
    } else {
      x_pos += draw_width;
    }
    ready = true;
  });
#endif
}

static void test_dma_rows() {
#if USE_DMA_INTERRUPT
  if(y_pos >= DISPLAY_HEIGHT) {
    return;
  }
#if TRACE_DEBUG
  Serial.print("[ "); Serial.print(x_pos); Serial.print(", "); Serial.print(y_pos); Serial.println(" ]");
#endif
  tft.drawPixelsAreaDMA((uint16_t*) test_arr_map, draw_height * draw_width, x_pos, y_pos, draw_width, nullptr, [](void* data) {
    if(x_pos + draw_width >= DISPLAY_WIDTH) {
      y_pos += draw_height;
      x_pos = 0;
    } else {
      x_pos += draw_width;
    }
    ready = true;
  });
#endif
}


void setup()
{
  // Enable interrupts for DMAC
  NVIC_EnableIRQ(DMAC_IRQn);
  Serial.begin(250000);
  Serial.println("\nRA8875 start");
  delay(1000);

  // All the pixels are green-ish
  for(unsigned short & pixel : test_pixels) {
    pixel = 0xAEAE;
  }

  /* Initialize the display using 'RA8875_480x80', 'RA8875_480x128', 'RA8875_480x272' or 'RA8875_800x480' */
  if (!tft.begin(RA8875_800x480)) {
    Serial.println("RA8875 Not Found!");
    while (1);
  }

  /**
   * Text mode doesn't like the high bus speeds for some reason
   * */
  tft.setClockSpeed(4000000);

  tft.displayOn(true);
  tft.GPIOX(true);      // Enable TFT - display enable tied to GPIOX
  tft.PWM1config(true, RA8875_PWM_CLK_DIV1024); // PWM output for backlight
  tft.PWM1out(255);
  tft.fillScreen(RA8875_BLACK);
  tft.graphicsMode();

  tft.setClockSpeed(4000000L);

  RA_SET_DEBUG(true);
  delay(1000);

}

void loop()
{
  delay(250);
  if(ready) {
    ready = false;
//  test_spi_blocking();
//  test_dma_regular();
    test_dma_rows();
  }
}

#if USE_DMA_INTERRUPT
ISR(DMAC_Handler) {
  RA_DEBUG_STOP(SPI_TIMING);
  RA_DEBUG_START(INTERRUPT);
  tft.onDMAInterrupt();
  RA_DEBUG_STOP(INTERRUPT);
}
#endif

// Declare this lower because it kind of gets in the way
// 80x80 box
// 80x20px red
// 80x20px green
// 80x20px blue
// 80x20px yellow
uint8_t test_arr_map[] = {
  0xd0, 0x00, 0xd0, 0x00, 0xd0, 0x00, 0xd0, 0x00, 0xd0, 0x00, 0xd0, 0x00,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 0x00,
  0xd0, 0x00, 0xd0, 0x00, 0xd0, 0x00, 0xd0, 0x00, 0xd0, 0x00, 0xd0, 0x00,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 0x00,
  0xd0, 0x00, 0xd0, 0x00, 0xd0, 0x00, 0xd0, 0x00, 0xd0, 0x00, 0xd0, 0x00,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 0x00,
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  0xde, 0x80, 0xde, 0x80, 0xde, 0x80, 0xde, 0x80, 0xde, 0x80, 0xde, 0x80,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 0x80,
};

#endif